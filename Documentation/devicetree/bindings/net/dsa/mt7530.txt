## Documentation/devicetree/bindings/net/dsa/mt7530.txt
```
Mediatek MT7530 Ethernet switch
================================

Required properties:

- compatible: may be compatible = "mediatek,mt7530"
	or compatible = "mediatek,mt7621"
- #address-cells: Must be 1.
- #size-cells: Must be 0.
- mediatek,mcm: Boolean; if defined, indicates that either MT7530 is the part
	on multi-chip module belong to MT7623A has or the remotely standalone
	chip as the function MT7623N reference board provided for.

If compatible mediatek,mt7530 is set then the following properties are required

- core-supply: Phandle to the regulator node necessary for the core power.
- io-supply: Phandle to the regulator node necessary for the I/O power.
	See Documentation/devicetree/bindings/regulator/mt6323-regulator.txt
	for details for the regulator setup on these boards.

If the property mediatek,mcm isn't defined, following property is required

- reset-gpios: Should be a gpio specifier for a reset line.

Else, following properties are required

- resets : Phandle pointing to the system reset controller with
	line index for the ethsys.
- reset-names : Should be set to "mcm".

Required properties for the child nodes within ports container:

- reg: Port address described must be 6 for CPU port and from 0 to 5 for
	user ports.
- phy-mode: String, must be either "trgmii" or "rgmii" for port labeled
	 "cpu".

In the case of a build-in MT7530 switch, port 5 shares the RGMII bus with
2nd GMAC and optional external phy.

Port 5 modes/configurations:
1. P5 is disabled: External phy can talk to 2nd GMAC.
2. P5 interface connects to connect PHY of P0/P4: P0/4 interfaces with 2nd GMAC.
   It is a simple mac to phy interface, Port 5 needs to be setup for rgmii modes.
   Used in many setups where P0/P4 becomes the WAN port of the device.
3. P5 interface connects to GMAC5 and talks to an external phy
   P5 becomes an extra switch port.
   Only works on platform where external phy TX<->RX lines are swapped.
4. P5 interface connects GMAC5 to 2nd gmac serves as 2nd CPU port.

Depening on how the externel phy is wired:
* normal: The phy can only connect to 2nd GMAC but not to the switch
* swapped:  RGMII TX, RX are swapped; external phy can connect the switch as a 
  ethernet port. But not to the 2nd GMAC.

Optional property:

- mediatek,ephy-handle: Phandle of the external phy. In case you want to use 
			P0/4 as WAN port and have an external phy attached.
			With this property the external phy is put in isolation
			and powerdown mode in mode 2.

Based on the DT the port 5 mode is configured.

Driver tries to lookup the phy-handle of the 2nd GMAC of the master device.
If it matches phy P0 or P4 then sets up mode 2 and when propertly
"mediatek,ephy-handle" is valid it puts the externel phy in isolation mode.
phy-mode must be set, see example 2 below!
mt7621: phy-mode = "rgmii-txid";
mt7623: phy-mode = "rgmii";

See Documentation/devicetree/bindings/net/dsa/dsa.txt for a list of additional
required, optional properties and how the integrated switch subnodes must
be specified.

Example:

	&mdio0 {
		switch@0 {
			compatible = "mediatek,mt7530";
			#address-cells = <1>;
			#size-cells = <0>;
			reg = <0>;

			core-supply = <&mt6323_vpa_reg>;
			io-supply = <&mt6323_vemc3v3_reg>;
			reset-gpios = <&pio 33 0>;

			ports {
				#address-cells = <1>;
				#size-cells = <0>;
				reg = <0>;
				port@0 {
					reg = <0>;
					label = "lan0";
				};

				port@1 {
					reg = <1>;
					label = "lan1";
				};

				port@2 {
					reg = <2>;
					label = "lan2";
				};

				port@3 {
					reg = <3>;
					label = "lan3";
				};

				port@4 {
					reg = <4>;
					label = "wan";
				};

				port@6 {
					reg = <6>;
					label = "cpu";
					ethernet = <&gmac0>;
					phy-mode = "trgmii";
					fixed-link {
						speed = <1000>;
						full-duplex;
					};
				};
			};
		};
	};

Example 2: 2nd GMAC -> P5 -> PHY P4 and a external phy.

&eth {
	status = "okay";

	gmac0: mac@0 {
		compatible = "mediatek,eth-mac";
		reg = <0>;
		phy-mode = "trgmii";

		fixed-link {
			speed = <1000>;
			full-duplex;
			pause;
		};
	};

	gmac1: mac@1 {
		compatible = "mediatek,eth-mac";
		reg = <1>;
		phy-mode = "rgmii-txid";
		phy-handle = <&phy4>;
	};

	mdio: mdio-bus {
		#address-cells = <1>;
		#size-cells = <0>;

		/* Internal phy */
		phy4: ethernet-phy@4 {
			reg = <4>;
		};

		/* external phy */
		ephy5: ethernet-phy@7 {
			reg = <7>;
		};

		mt7530: switch@1f {
			compatible = "mediatek,mt7621";
			#address-cells = <1>;
			#size-cells = <0>;
			reg = <0x1f>;
			pinctrl-names = "default";
			mediatek,mcm;

			resets = <&rstctrl 2>;
			reset-names = "mcm";
			/* Put this external phy in power-down and isolation
			 * when port 5 is used in PHY P0/P4 or DSA mode. Because
			 * external phy and port 5 share same bus to 2nd GMAC.
			 */
			mediatek,ephy-handle = <&ephy5>;

			ports {
				#address-cells = <1>;
				#size-cells = <0>;
		
				port@0 {
					reg = <0>;
					label = "lan0";
				};
		
				port@1 {
					reg = <1>;
					label = "lan1";
				};
		
				port@2 {
					reg = <2>;
					label = "lan2";
				};
		
				port@3 {
					reg = <3>;
					label = "lan3";
				};

/*
				port@4 {
					reg = <4>;
					label = "lan4";
				};
*/

				cpu_port0: port@6 {
					reg = <6>;
					label = "cpu";
					ethernet = <&gmac0>;
					phy-mode = "trgmii";

					fixed-link {
						speed = <1000>;
						full-duplex;
						pause;
					};
				};
			};
		};
	};
};
```

## drivers/clk/ralink/Kconfig
```kconfig
# SPDX-License-Identifier: GPL-2.0-only
#
# MediaTek Mt7621 Clock Driver
#
menu "Clock driver for Mediatek mt7621 SoC"
	depends on SOC_MT7621 || COMPILE_TEST

config CLK_MT7621
	bool "Clock driver for MediaTek MT7621"
	depends on SOC_MT7621 || COMPILE_TEST
	default SOC_MT7621
	select MFD_SYSCON
	help
	  This driver supports MediaTek MT7621 basic clocks.
endmenu
```

## drivers/net/ethernet/mediatek/Kconfig
```kconfig
# SPDX-License-Identifier: GPL-2.0-only
config NET_VENDOR_MEDIATEK
	bool "MediaTek ethernet driver"
	depends on ARCH_MEDIATEK || SOC_MT7621 || SOC_MT7620
	---help---
	  If you have a Mediatek SoC with ethernet, say Y.

if NET_VENDOR_MEDIATEK

config NET_MEDIATEK_SOC
	tristate "MediaTek SoC Gigabit Ethernet support"
	select PHYLINK
	select PAGE_POOL
	---help---
	  This driver supports the gigabit ethernet MACs in the
	  MediaTek SoC family.

if NET_MEDIATEK_SOC

config MEDIATEK_SOC_SELFTESTS
	bool "Support for MediaTek SoC Ethernet Selftests"
	depends on INET
	depends on NET_MEDIATEK_SOC
	default n
	---help---
	  This adds support for MediaTek Selftests using ethtool. Enable this
	  feature if you are facing problems with your HW and submit the test
	  results to the netdev Mailing List.

endif #MEDIATEK_SOC_SELFTESTS

endif #NET_VENDOR_MEDIATEK
```
